## kernel/defconfig
```kconfig
CONFIG_64BIT=y
CONFIG_SMP=y
CONFIG_BLK_DEV_NVME=y
CONFIG_SATA_AHCI=y
CONFIG_EXT4_FS=y
CONFIG_BTRFS_FS=y
CONFIG_VFAT_FS=y
CONFIG_NAMESPACES=y
CONFIG_CGROUPS=y
CONFIG_OVERLAY_FS=y
CONFIG_NET=y
CONFIG_INET=y
CONFIG_NETDEVICES=y
CONFIG_E1000E=y
CONFIG_IGB=y
CONFIG_R8169=y
CONFIG_MAC80211=y
CONFIG_IWLWIFI=y
CONFIG_FW_LOADER=y
CONFIG_TMPFS=y
CONFIG_DEVTMPFS=y
CONFIG_DEVTMPFS_MOUNT=y
```
